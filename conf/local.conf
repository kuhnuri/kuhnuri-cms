## conf/local.conf
```bitbake
include "application.conf"

projects {
  basedir = "/Users/jelovirt/Work/dita-ot-platform/dita-ot-platform-cms/test"
}
//db {
//  default.driver = "org.postgresql.Driver"
//  default.url = "jdbc:postgresql://localhost/queue?user=play"
//  default.username = "play"
//}
play.crypto.secret = "j`1L]T7whPk<@2Q:/TLvI^`qKiK^ZL6zyza5lz9yQY>ifmsE8/?II:]?16dTp24:"
```
